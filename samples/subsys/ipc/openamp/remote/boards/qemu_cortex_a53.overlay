/*
 * Copyright (c) 2022 openEuler Embedded
 *
 * SPDX-License-Identifier: Apache-2.0
 */

#include "../../boards/qemu_cortex_a53_overlay.dtsi"

/ {
	chosen {
		zephyr,sram = &sram1;
		zephyr,console = &uart1;
		zephyr,shell-uart = &uart1;
	};

};

&uart0 {
	status = "disabled";
};

&uart1 {
	status = "okay";
	current-speed = <115200>;
};
