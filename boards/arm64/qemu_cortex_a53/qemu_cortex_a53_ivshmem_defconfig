## boards/arm64/qemu_cortex_a53/qemu_cortex_a53_ivshmem_defconfig
```kconfig
CONFIG_SOC_QEMU_CORTEX_A53=y
CONFIG_BOARD_QEMU_CORTEX_A53=y
CONFIG_ARM_ARCH_TIMER=y
CONFIG_QEMU_ICOUNT=n

# Cache management
CONFIG_CACHE_MANAGEMENT=y

# Enable UART driver
CONFIG_SERIAL=y

# Enable console
CONFIG_CONSOLE=y
# no early console, because uart_rpmsg is used
CONFIG_EARLY_CONSOLE=y
CONFIG_UART_CONSOLE=y
CONFIG_PRINTK=y

# to use remote, must be in Non-Secure world
CONFIG_ARMV8_A_NS=y

# Enable RPMSG based serial port
CONFIG_UART_RPMSG=y
CONFIG_UART_INTERRUPT_DRIVEN=y

CONFIG_OPENAMP=y
CONFIG_RPMSG_SERVICE_MODE_REMOTE=y
CONFIG_OPENAMP_MASTER=n
CONFIG_OPENAMP_RSC_TABLE_NUM_RPMSG_BUFF=8
CONFIG_OPENAMP_RSC_TABLE=y
CONFIG_HEAP_MEM_POOL_SIZE=4096
# shell must be initialized after uart_rpmsg
CONFIG_SHELL_BACKEND_SERIAL_INIT_PRIORITY=60
# the tx ring buffer size is the same of bufffer of rpmsg_virtio buffer
CONFIG_SHELL_BACKEND_SERIAL_TX_RING_BUFFER_SIZE=512

CONFIG_IPM=n

CONFIG_PCIE=y
CONFIG_POLL=y
CONFIG_PCIE_CONTROLLER=y
CONFIG_PCIE_ECAM=y
CONFIG_KERNEL_VM_SIZE=0x80000000

# Hungry PCI requires phys addresses with more than 32 bits
CONFIG_ARM64_VA_BITS_40=y
CONFIG_ARM64_PA_BITS_40=y

CONFIG_VIRTUALIZATION=y
CONFIG_IVSHMEM=y
CONFIG_IVSHMEM_V2=y
CONFIG_IVSHMEM_DOORBELL=y
CONFIG_DYNAMIC_INTERRUPTS=y
# the correct init order:
# serial->pci controler->
# ->pci scan->pci device(ivshmem)
# ->virtio->rpmsg endpoint
CONFIG_SERIAL_INIT_PRIORITY=31
CONFIG_CONSOLE_INIT_PRIORITY=32
CONFIG_KERNEL_INIT_PRIORITY_DEVICE=41

CONFIG_LOG=y
CONFIG_LOG_BACKEND_UART=y
```

## boards/arm64/qemu_cortex_a53/qemu_cortex_a53_remote_defconfig
```kconfig
CONFIG_SOC_QEMU_CORTEX_A53=y
CONFIG_BOARD_QEMU_CORTEX_A53=y
CONFIG_ARM_ARCH_TIMER=y
CONFIG_QEMU_ICOUNT=n

# Cache management
CONFIG_CACHE_MANAGEMENT=y

# Enable UART driver
CONFIG_SERIAL=y

# Enable console
CONFIG_CONSOLE=y
# no early console, because uart_rpmsg is used
CONFIG_BOOT_BANNER=n
CONFIG_EARLY_CONSOLE=n
CONFIG_UART_CONSOLE=y

# to use remote, must be in Non-Secure world
CONFIG_ARMV8_A_NS=y

# Enable RPMSG based serial port
CONFIG_UART_RPMSG=y
CONFIG_UART_INTERRUPT_DRIVEN=y

CONFIG_OPENAMP=y
CONFIG_IPM=y
CONFIG_RPMSG_SERVICE_MODE_REMOTE=y
CONFIG_OPENAMP_MASTER=n
CONFIG_HEAP_MEM_POOL_SIZE=4096
# shell must be initialized after uart_rpmsg
CONFIG_SHELL_BACKEND_SERIAL_INIT_PRIORITY=60
# the tx ring buffer size is the same of bufffer of rpmsg_virtio buffer
CONFIG_SHELL_BACKEND_SERIAL_TX_RING_BUFFER_SIZE=512
```

## boards/arm64/rpi4_cortex_a72/Kconfig.board
```kconfig
# Copyright (c) 2022 openEuler Embedded
# SPDX-License-Identifier: Apache-2.0

config BOARD_RPI4_CORTEX_A72
	bool "Raspberry Pi 4B"
	depends on SOC_RPI4_CORTEX_A72
	select ARM64
```

## boards/arm64/rpi4_cortex_a72/Kconfig.defconfig
```kconfig
# Copyright (c) 2022 openEuler Embedded
# SPDX-License-Identifier: Apache-2.0

if BOARD_RPI4_CORTEX_A72

config BUILD_OUTPUT_BIN
	default y

config BOARD
	default "rpi4_cortex_a72"

if IPM

config IPM_GIC_SGI
	default y

endif # IPM

endif # BOARD_RPI4_CORTEX_A72
```

## boards/arm64/rpi_4b/rpi_4b_ivshmem_defconfig
```kconfig
# SPDX-License-Identifier: Apache-2.0

# Platform Configuration
CONFIG_SOC_BCM2711=y
CONFIG_BOARD_RPI_4B=y
CONFIG_ARM64_VA_BITS_36=y
CONFIG_ARM64_PA_BITS_36=y

# Zephyr Kernel Configuration
CONFIG_XIP=n
CONFIG_FLASH_SIZE=0
CONFIG_FLASH_BASE_ADDRESS=0x0

# Serial Drivers
CONFIG_SERIAL=y
CONFIG_UART_INTERRUPT_DRIVEN=y

# Enable Console
CONFIG_CONSOLE=y
CONFIG_UART_CONSOLE=y
CONFIG_PRINTK=y

# Timer Drivers
CONFIG_TIMER_READS_ITS_FREQUENCY_AT_RUNTIME=y


CONFIG_ARMV8_A_NS=y
# Enable RPMSG based serial port
CONFIG_UART_RPMSG=y
CONFIG_UART_INTERRUPT_DRIVEN=y

CONFIG_OPENAMP=y
CONFIG_RPMSG_SERVICE_MODE_REMOTE=y
CONFIG_OPENAMP_MASTER=n
CONFIG_OPENAMP_RSC_TABLE_NUM_RPMSG_BUFF=8
CONFIG_OPENAMP_RSC_TABLE=y
CONFIG_HEAP_MEM_POOL_SIZE=4096
# shell must be initialized after uart_rpmsg
CONFIG_SHELL_BACKEND_SERIAL_INIT_PRIORITY=60
# the tx ring buffer size is the same of bufffer of rpmsg_virtio buffer
CONFIG_SHELL_BACKEND_SERIAL_TX_RING_BUFFER_SIZE=512

CONFIG_IPM=n

CONFIG_PCIE=y
CONFIG_POLL=y
CONFIG_PCIE_CONTROLLER=y
CONFIG_PCIE_ECAM=y
CONFIG_KERNEL_VM_SIZE=0x80000000

CONFIG_VIRTUALIZATION=y
CONFIG_IVSHMEM=y
CONFIG_IVSHMEM_V2=y
CONFIG_IVSHMEM_DOORBELL=y
CONFIG_DYNAMIC_INTERRUPTS=y
# the correct init order:
# serial->pci controler->
# ->pci scan->pci device(ivshmem)
# ->virtio->rpmsg endpoint
CONFIG_SERIAL_INIT_PRIORITY=41
CONFIG_CONSOLE_INIT_PRIORITY=42
CONFIG_PCIE_INIT_PRIORITY=43
CONFIG_KERNEL_INIT_PRIORITY_DEVICE=44

CONFIG_LOG=y
CONFIG_LOG_BACKEND_UART=y
CONFIG_LOG_MODE_IMMEDIATE=y
CONFIG_KERNEL_DIRECT_MAP=y
# don't use shell log backend, as shell is on rpmsg-tty
CONFIG_SHELL_LOG_BACKEND=n
CONFIG_RPMSG_SERVICE_LOG_LEVEL_DBG=y
```

## boards/arm64/rpi_4b/rpi_4b_remote_defconfig
```kconfig
# Copyright (c) 2024 openEuler Embedded
# SPDX-License-Identifier: Apache-2.0

# Platform Configuration
CONFIG_SOC_BCM2711=y
CONFIG_BOARD_RPI_4B=y
CONFIG_ARM64_VA_BITS_36=y
CONFIG_ARM64_PA_BITS_36=y

# Zephyr Kernel Configuration
CONFIG_XIP=n

# Cache management
CONFIG_CACHE_MANAGEMENT=y

# Serial Drivers
CONFIG_SERIAL=y
CONFIG_UART_INTERRUPT_DRIVEN=y

# Enable Console
CONFIG_CONSOLE=y
# no early console, because uart_rpmsg is used
CONFIG_BOOT_BANNER=n
CONFIG_EARLY_CONSOLE=n
CONFIG_UART_CONSOLE=y
CONFIG_PRINTK=y

# Timer Drivers
CONFIG_TIMER_READS_ITS_FREQUENCY_AT_RUNTIME=y


CONFIG_ARMV8_A_NS=y

# Enable RPMSG based serial port
CONFIG_UART_RPMSG=y
CONFIG_UART_INTERRUPT_DRIVEN=y

# support psci ops
CONFIG_PM_CPU_OPS=y
CONFIG_OPENAMP=y
CONFIG_IPM=y
CONFIG_RPMSG_SERVICE_MODE_REMOTE=y
CONFIG_OPENAMP_MASTER=n
CONFIG_OPENAMP_RSC_TABLE_NUM_RPMSG_BUFF=8
CONFIG_OPENAMP_RSC_TABLE=y
CONFIG_HEAP_MEM_POOL_SIZE=4096
# shell must be initialized after uart_rpmsg
CONFIG_SHELL_BACKEND_SERIAL_INIT_PRIORITY=60
# the tx ring buffer size is the same of bufffer of rpmsg_virtio buffer
CONFIG_SHELL_BACKEND_SERIAL_TX_RING_BUFFER_SIZE=512

CONFIG_LOG=y
CONFIG_LOG_BACKEND_UART=y
CONFIG_LOG_MODE_IMMEDIATE=y
# don't use shell log backend, as shell is on rpmsg-tty
CONFIG_SHELL_LOG_BACKEND=n
```

## drivers/ipm/Kconfig
```kconfig
# SPDX-License-Identifier: Apache-2.0

menuconfig IPM
	bool "Inter-Processor Mailbox (IPM) drivers"
	help
	  Include interrupt-based inter-processor mailboxes
	  drivers in system configuration

if IPM

config IPM_MHU
	bool "IPM MHU driver"
	default y
	depends on DT_HAS_ARM_MHU_ENABLED
	help
	  Driver for SSE 200 MHU (Message Handling Unit)

config IPM_NRFX
	bool "IPM NRF driver"
	default y
	depends on DT_HAS_NORDIC_NRF_IPC_ENABLED
	select NRFX_IPC
	help
	  Driver for Nordic nRF messaging unit, based
	  on nRF IPC peripheral HW.

config IPM_NRF_SINGLE_INSTANCE
	bool "Single instance of IPM device"
	help
	  Enable this option if the IPM device should have
	  a single instance, instead of one per IPC
	  message channel.

config ESP32_SOFT_IPM
	bool "ESP32 Software IPM driver"
	default y
	depends on DT_HAS_ESPRESSIF_ESP32_IPM_ENABLED
	help
	  Interprocessor driver for ESP32 when using AMP.

source "drivers/ipm/Kconfig.nrfx"
source "drivers/ipm/Kconfig.imx"
source "drivers/ipm/Kconfig.stm32"
source "drivers/ipm/Kconfig.intel_adsp"

config IPM_GIC_SGI
	bool "ARM GIC SGI driver"
	depends on GIC
	help
	  use ARM GIC SGI interrupt as IPM

if IPM_GIC_SGI

config IPM_GIC_SGI_INTNO
	int "Intno of SGI used for IPM"
	range 6 7
	default 7
	help
	  The intno of SGI used for IPM. For arm64, SGI can be used to
	  work as IPM

endif # IPM_GIC_SGI

module = IPM
module-str = ipm
source "subsys/logging/Kconfig.template.log_config"

endif #IPM
```

## drivers/serial/Kconfig.rpmsg_uart
```kconfig
# Rpmsg service based UART
#
# Copyright (c) 2022 openEuler Embedded
# SPDX-License-Identifier: Apache-2.0

config UART_RPMSG
	bool "RPMSG service based UART driver"
	select SERIAL_HAS_DRIVER
	select SERIAL_SUPPORT_INTERRUPT
	select RPMSG_SERVICE
	select RING_BUFFER
	help
		Enable RPMSG service based uart driver. Zephyr runs as
		a remote OS

if UART_RPMSG

config UART_RPMSG_RING_BUF_SIZE
	int "RPMSG UART receive ring buf size"
	default 512
	help
	  Set the size of ring buffer used for rpmsg uart receive

config UART_RPMSG_LINE_BUF_SIZE
	int "RPMSG UART poll line buf size"
	default 32
	help
	  Set the size of line buffer used for rpmsg uart poll out

endif # UART_RPMSG
```

## dts/bindings/serial/zephy,rpmsg-uart.yaml
```yaml
# Copyright (c) 2022, openEuler Embedded
# SPDX-License-Identifier: Apache-2.0

description: RPMSG service based UART

compatible: "zephyr,rpmsg-uart"

include: uart-controller.yaml
```

## soc/arm64/rpi4_cortex_a72/Kconfig.defconfig
```kconfig
# Copyright (c) 2022 openEuler Embedded
# SPDX-License-Identifier: Apache-2.0

if SOC_RPI4_CORTEX_A72

config SOC
	default "rpi4_cortex_a72"

config NUM_IRQS
	# must be >= the highest interrupt number used
	# - include the UART interrupts
	default 100

config SYS_CLOCK_HW_CYCLES_PER_SEC
	default 54000000

endif # SOC_RPI4_CORTEX_A72
```

## soc/arm64/rpi4_cortex_a72/Kconfig.soc
```kconfig
# Copyright (c) 2022 openEuler Embedded
# SPDX-License-Identifier: Apache-2.0

config SOC_RPI4_CORTEX_A72
	bool "Raspberry Pi 4 (cortex-a72)"
	select ARM64
	select CPU_CORTEX_A72
	select GIC_V2
```
